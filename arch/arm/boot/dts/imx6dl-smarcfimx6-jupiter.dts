/*
 * Copyright (C) 2017 Matthews Swedot
 *
 * This program is free software; you can redistribute it and/or modify
 * it under the terms of the GNU General Public License version 2 as
 * published by the Free Software Foundation.
 */

#include "imx6dl-smarcfimx6.dts"
#include "imx6qdl-smarcfimx6-jupiter.dtsi"

/ {
	model = "Matthews Jupiter SMARC-FiMX6 DualLite";
	compatible = "fsl,imx6dl", "fsl,imx6dl-smarcfimx6";
};

